## configs/raspberrypi3_softbot_defconfig
```kconfig
BR2_arm=y
BR2_cortex_a53=y
BR2_ARM_FPU_NEON_VFPV4=y

BR2_TOOLCHAIN_BUILDROOT_CXX=y

BR2_SYSTEM_DHCP="eth0"

# Linux headers same as kernel, a 4.14 series
BR2_PACKAGE_HOST_LINUX_HEADERS_CUSTOM_4_14=y

BR2_LINUX_KERNEL=y
BR2_LINUX_KERNEL_CUSTOM_TARBALL=y
BR2_LINUX_KERNEL_CUSTOM_TARBALL_LOCATION="$(call github,raspberrypi,linux,6d27aa156c26977dfd079a7107e31670127d17d3)/linux-6d27aa156c26977dfd079a7107e31670127d17d3.tar.gz"
BR2_LINUX_KERNEL_DEFCONFIG="bcm2709"

# Build the DTB from the kernel sources
BR2_LINUX_KERNEL_DTS_SUPPORT=y
BR2_LINUX_KERNEL_INTREE_DTS_NAME="bcm2710-rpi-3-b bcm2710-rpi-3-b-plus bcm2710-rpi-cm3"

BR2_PACKAGE_RPI_FIRMWARE=y

# Required tools to create the SD image
BR2_PACKAGE_HOST_DOSFSTOOLS=y
BR2_PACKAGE_HOST_GENIMAGE=y
BR2_PACKAGE_HOST_MTOOLS=y

# Filesystem / image
BR2_TARGET_ROOTFS_EXT2=y
BR2_TARGET_ROOTFS_EXT2_4=y
BR2_TARGET_ROOTFS_EXT2_SIZE="1G"
# BR2_TARGET_ROOTFS_TAR is not set
BR2_ROOTFS_POST_BUILD_SCRIPT="board/raspberrypi3/post-build.sh"
BR2_ROOTFS_POST_IMAGE_SCRIPT="board/raspberrypi3/post-image.sh"
BR2_ROOTFS_POST_SCRIPT_ARGS="--add-pi3-miniuart-bt-overlay --waveshare --gpu_mem_256=128 --gpu_mem_512=196 --gpu_mem_1024=396"

# SOFTBOT
BR2_TARGET_GENERIC_ROOT_PASSWD="softbot"
BR2_PACKAGE_RPI_FIRMWARE_X=y
BR2_PACKAGE_LTRACE=y
#BR2_TOOLCHAIN_BUILDROOT_MUSL=y
BR2_TOOLCHAIN_BUILDROOT_GLIBC=y
BR2_TARGET_OPTIMIZATION="-mthumb -mfpu=neon-fp-armv8 -mtune=cortex-a53"

BR2_PACKAGE_GST1_PLUGINS_GOOD_PLUGIN_RTP=y
BR2_PACKAGE_GST1_PLUGINS_GOOD_PLUGIN_UDP=y
BR2_PACKAGE_GST1_PLUGINS_GOOD_PLUGIN_VPX=y
BR2_PACKAGE_GST1_RPICAMSRC=y
BR2_PACKAGE_GST1_PLUGINS_BAD_PLUGIN_WEBRTCDSP=y

BR2_PACKAGE_ALSA_LIB=y
BR2_PACKAGE_ALSA_UTILS=y
BR2_PACKAGE_ALSA_UTILS_APLAY=y
BR2_PACKAGE_PULSEAUDIO=y

BR2_PACKAGE_SOFTBOT_SCRIPTS=y
BR2_PACKAGE_HOST_CARGO=y
BR2_PACKAGE_HOST_RUST=y
BR2_PACKAGE_HOST_RUSTC=y
BR2_PACKAGE_SOFT_CONTROL_RUST=y
BR2_PACKAGE_HOST_RUSTC_ABI="eabihf"
BR2_PACKAGE_HOST_RUSTC_TARGET_ARCH_SUPPORTS=y


# WPE Webkit
BR2_GCC_ENABLE_GRAPHITE=y
BR2_TOOLCHAIN_BUILDROOT_WCHAR=y
BR2_TOOLCHAIN_BUILDROOT_LOCALE=y
BR2_ROOTFS_DEVICE_CREATION_DYNAMIC_EUDEV=y
#BR2_PACKAGE_HOST_GDB=y
#BR2_PACKAGE_HOST_GDB_TUI=y
#BR2_PACKAGE_GDB=y
#BR2_PACKAGE_GDB_SERVER=y
#BR2_PACKAGE_GDB_DEBUGGER=y
#BR2_PACKAGE_GDB_TUI=y
#BR2_PACKAGE_STRACE=y
BR2_PACKAGE_BITSTREAM_VERA=y
BR2_PACKAGE_RPI_USERLAND=y
BR2_PACKAGE_RPI_USERLAND_START_VCFILED=y
BR2_PACKAGE_DROPBEAR=y
BR2_PACKAGE_NTP=y
BR2_PACKAGE_NTP_NTPDATE=y
BR2_PACKAGE_COG=y
BR2_PACKAGE_COG_PROGRAMS=y
BR2_PACKAGE_COG_PROGRAMS_DBUS_SYSTEM_BUS=y
BR2_PACKAGE_COG_PROGRAMS_HOME_URI="https://wpewebkit.org"
BR2_PACKAGE_EGLINFO=y
BR2_PACKAGE_WPEWEBKIT=y
BR2_PACKAGE_WPEWEBKIT_BUILD_JSC=y
BR2_PACKAGE_WPEWEBKIT_MULTIMEDIA=y
BR2_PACKAGE_WPEWEBKIT_MINIBROWSER=y
BR2_PACKAGE_WPEWEBKIT_MINIBROWSER_BACKEND_FDO=y
BR2_PACKAGE_LIBWPE=y
BR2_PACKAGE_WPEBACKEND_RDK=y
BR2_PACKAGE_GLIB_NETWORKING=y
BR2_PACKAGE_GNUTLS=y
BR2_PACKAGE_GST1_PLUGINS_BASE_LIB_OPENGL=y
BR2_PACKAGE_WPEWEBKIT_USE_GSTREAMER_GL=y
BR2_PACKAGE_GST_OMX=y
BR2_PACKAGE_GST1_PLUGINS_GOOD_PLUGIN_AUTODETECT=y
BR2_PACKAGE_GST1_PLUGINS_GOOD_PLUGIN_AUDIOPARSERS=y
BR2_PACKAGE_GST1_PLUGINS_BASE_PLUGIN_AUDIOTESTSRC=y
BR2_PACKAGE_GST1_PLUGINS_BASE_PLUGIN_ALSA=y
BR2_PACKAGE_GST1_PLUGINS_GOOD_PLUGIN_INTERLEAVE=y
BR2_PACKAGE_GST1_PLUGINS_BASE_PLUGIN_GIO=y
BR2_PACKAGE_GST1_PLUGINS_BASE_PLUGIN_OPUS=y
BR2_PACKAGE_GST1_PLUGINS_BASE_PLUGIN_AUDIOMIXER=y
BR2_PACKAGE_GST1_PLUGINS_BASE_PLUGIN_AUDIORATE=y
BR2_PACKAGE_GST1_PLUGINS_GOOD_PLUGIN_PULSE=y
BR2_PACKAGE_CA_CERTIFICATES=y
BR2_PACKAGE_OPENSSL=y
```

## package/gstreamer1/gst1-rpicamsrc/Config.in
```kconfig
config BR2_PACKAGE_GST1_RPICAMSRC
	bool "gst1-rpicamsrc"
	help
	  Raspberry Pi camera support for GStreamer1

	  https://github.com/thaytan/gst-rpicamsrc
```

## package/softbot-scripts/Config.in
```kconfig
config BR2_PACKAGE_SOFTBOT_SCRIPTS
    bool "Sofbot scripts"
    help
      A collection of scripts for starting softbot
```
